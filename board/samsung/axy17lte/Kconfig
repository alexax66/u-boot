## board/samsung/axy17lte/Kconfig
```kconfig
config SYS_CONFIG_NAME
	string "Board configuration name"
	default "exynos78x0-common.h"
	help
	  This option contains information about board configuration name.
	  Based on this option include/configs/<CONFIG_SYS_CONFIG_NAME>.h header
	  will be used for board configuration.

if TARGET_A5Y17LTE
config SYS_BOARD
	default "axy17lte"
	help
	  a5y17lte is a production board for SM-A520F phone on Exynos7880 SoC.

config SYS_VENDOR
	default "samsung"

config SYS_CONFIG_NAME
	default "a5y17lte"

config EXYNOS7880
	bool "Exynos 7880 SOC support"
	default y
endif

if TARGET_A7Y17LTE
config SYS_BOARD
	default "axy17lte"
	help
	  a7y17lte is a production board for SM-A720F phone on Exynos7880 SoC.

config SYS_VENDOR
	default "samsung"

config SYS_CONFIG_NAME
	default "a5y17lte"

config EXYNOS7880
	bool "Exynos 7880 SOC support"
	default y
endif

if TARGET_A3Y17LTE
config SYS_BOARD
	default "axy17lte"
	help
	  a3y17lte is a production board for SM-A320F phone on Exynos7870 SoC.

config SYS_VENDOR
	default "samsung"

config SYS_CONFIG_NAME
	default "a3y17lte"

config EXYNOS7870
	bool "Exynos 7870 SOC support"
	default y
endif

if TARGET_A6LTE
config SYS_BOARD
	default "axy17lte"
	help
	  a6lte is a production board for SM-A600F phone on Exynos7870 SoC.

config SYS_VENDOR
	default "samsung"

config SYS_CONFIG_NAME
	default "a6lte"

config EXYNOS7870
	bool "Exynos 7870 SOC support"
	default y
endif

if TARGET_J5Y17LTE
config SYS_BOARD
	default "axy17lte"
	help
	  j5y17lte is a production board for SM-J530F phone on Exynos7870 SoC.

config SYS_VENDOR
	default "samsung"

config SYS_CONFIG_NAME
	default "j5y17lte"

config EXYNOS7870
	bool "Exynos 7870 SOC support"
	default y
endif

if TARGET_J6LTE
config SYS_BOARD
	default "axy17lte"
	help
	  j6lte is a production board for SM-J600F phone on Exynos7870 SoC.

config SYS_VENDOR
	default "samsung"

config SYS_CONFIG_NAME
	default "j6lte"

config EXYNOS7870
	bool "Exynos 7870 SOC support"
	default y
endif

if TARGET_J7VELTE
config SYS_BOARD
	default "axy17lte"
	help
	  j7velte is a production board for SM-J701F phone on Exynos7870 SoC.

config SYS_VENDOR
	default "samsung"

config SYS_CONFIG_NAME
	default "j7velte"

config EXYNOS7870
	bool "Exynos 7870 SOC support"
	default y
endif

if TARGET_J7Y17LTE
config SYS_BOARD
	default "axy17lte"
	help
	  j7y17lte is a production board for SM-J730F phone on Exynos7870 SoC.

config SYS_VENDOR
	default "samsung"

config SYS_CONFIG_NAME
	default "j7y17lte"

config EXYNOS7870
	bool "Exynos 7870 SOC support"
	default y
endif

if TARGET_J7XELTE
config SYS_BOARD
	default "axy17lte"
	help
	  j7xelte is a production board for SM-J710F phone on Exynos7870 SoC.

config SYS_VENDOR
	default "samsung"

config SYS_CONFIG_NAME
	default "j7xelte"

config EXYNOS7870
	bool "Exynos 7870 SOC support"
	default y
endif

if TARGET_ON7XELTE
config SYS_BOARD
	default "axy17lte"
	help
	  on7xelte is a production board for SM-G610F phone on Exynos7870 SoC.

config SYS_VENDOR
	default "samsung"

config SYS_CONFIG_NAME
	default "on7xelte"

config EXYNOS7870
	bool "Exynos 7870 SOC support"
	default y
endif
```
